#include "PWM.h"

uint8_t counter=FREQ_T3, // Количество импульсов на 100% ШИМ
		pwm_ten=0, // Уровень ШИМ [0;100] (ТЭН)
		pwm_ten_buf=0; // Копия уровня ШИМ до начала преобразования
		
//----------ПЕРЕМЕННЫЕ ДЛЯ ПИД (ТЕМПЕРАТУРА)---------
float pwm_val = 0.000001; // Сигнал управления (изначально равен 0)
float ef = 0.000001; // Текущее значение ошибки
float e0 = 0.000001, // Нулевой такт ошибки (предыдущая ошибка)
	  e1 = 0.000001; // Первый такт ошибки (текущая ошибка)
float Kp = 9.6,   // Коэф-т пропорциональности
	  Ki = 0.0339, // Время интегрирования Ki=1/Ti
	  Td = 6.375;   // Время дифференцирования
float integral = 0.000001; // Интегральная составляющая
float dif = 0.000001; // Дифференциальная составляющая
extern uint8_t start; // Флаг команды "Старт"
//===================================================

INIT(7){ // Инициализация ШИМ
	DDR(PORT_PWMMOT) |= _BV(PIN_PWMMOT); // Пин PWMMOT_PIN_NUM порта PWMMOT_DDR на выход (МОТОР) OCR1B
	TCCR1A |= (0<<COM1A1)|(0<<COM1A0) //  Вывод OC1A | Стр. 106 даташита на Atmega128
		     |(1<<COM1B1)|(0<<COM1B0) //->Вывод OC1B | 
		     |(0<<COM1C1)|(0<<COM1C0) //  Вывод OC1C | 
		     |(0<<WGM11)|(1<<WGM10); // Режимы работы таймера-счетчика 1 (8-разр. (255) быстрая ШИМ)
	TCCR1B |= (0<<WGM13)|(1<<WGM12)  // Стр. 107 даташита на Atmega128
		     |(0<<CS12)|(0<<CS11)|(1<<CS10); // Выбор тактового источника (F_CPU/O/1=7372800/1024/1=7200Гц). Стр. 109 даташита на Atmega128
	//-----------------------------------------------------------------------------------
	DDR(PORT_PWMTEN) |= _BV(PIN_PWMTEN); // Пин PWM_PIN_NUM порта PWM_DDR на выход (ТЭН)
	TEN_OFF; // Выключаем ТЭН
	//-----------------------------------------------------------------------------------
	// Таймер 3
	//-----------------------------------------------------------------------------------
	OCR3A = COMPARE_T3; // Регистр сравнения таймера-счетчика 3
	TCCR3B |= (1<<WGM32) // Сброс таймера-счетчика 3 при совпадении
			 |(0<<CS32)|(1<<CS31)|(0<<CS30); // Выбор делителя (F_CPU/8/9216=100Гц). Стр. 109 даташита на Atmega128
	ETIMSK |= (1<<OCIE3A); // Разрешение прерывания при совпадении канала A таймера-счетчика 3
	//-----------------------------------------------------------------------------------
}

//------Прерывание при совпадении таймера-счетчика 3--------
ISR (TIMER3_COMPA_vect){ // Считает до 9216 и сбрасывается в 0 (F_CPU/8/9216=100Гц)
	//--------------------------------
	// ПИД: вычисляем сигнал задания 1 раз в секунду
	//--------------------------------
	if (start){
		e0 = e1; // Нулевой такт ошибки (предыдущая ошибка)
		e1 = ef; // Первый такт ошибки (текущая ошибка)
		integral += (Ki*e1); // Интеграл - это сумма (постоянно складываем интегральную составляющую с предыдущим значением)
		dif = Td*(e1 - e0); // Дифференциал
		pwm_val = (Kp*e1) + integral + dif; // Сигнал управления (установленное значение ШИМ)
		//_____Устанавливаем новое значение ШИМ_____
		if (pwm_val<0) pwm_ten = 0; // Если сигнал задания меньше 0
		else if ((pwm_val>=0) && (pwm_val<=FREQ_T3)) pwm_ten = (uint8_t)pwm_val; // Устанавливаем уровень ШИМ [0;100]
		else if (pwm_val>FREQ_T3) pwm_ten = FREQ_T3; // Если сигнал задания больше 100
		//__________________________________________
	}
	//--------------------------------
	// Установка значения ШИМ
	//--------------------------------
		// Счетчик ШИМ (F=1Гц, T=1с):
		if (--counter == 0){ // Если счетчик досчитал до 0
			TEN_OFF; // Выключаем ТЭН
			LED_TEN_OFF; // Выключаем светодиод ТЭН
			counter = FREQ_T3; // Задаем начальное значение - 100 импульсов
			pwm_ten_buf = pwm_ten; // Значение длительности ШИМ
		}
		if (counter == pwm_ten_buf){ // Если счетчик досчитал до установленного значения ШИМ
			TEN_ON; // Включаем ТЭН
			LED_TEN_ON; // Включаем светодиод ТЭН
		}
	//--------------------------------
}
//-----------------------------------------------------------